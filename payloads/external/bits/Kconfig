## payloads/external/bits/Kconfig
```kconfig
if GRUB_BITS

choice
	prompt "BITS version"
	default BITS_STABLE

config BITS_STABLE
	bool "bits-2079"
	help
	  Stable BITS version

config BITS_MASTER
	bool "master"
	help
	  Newest BITS version

config BITS_REVISION
	bool "git revision"
	help
	  Select this option if you have a specific commit or branch
	  that you want to use as the revision from which to
	  build BITS.

	  You will be able to specify the name of a branch or a commit id
	  later.

endchoice

config BITS_REVISION_ID
	string "Insert a commit's SHA-1 or a branch name for BITS"
	depends on BITS_REVISION
	default "origin/master"
	help
	   The commit's SHA-1 or branch name of the revision to use.

endif
```

## payloads/external/skiboot/Kconfig
```kconfig
## SPDX-License-Identifier: GPL-2.0-only

if PAYLOAD_SKIBOOT

config PAYLOAD_FILE
	default "payloads/external/skiboot/skiboot.uimage"

endif #PAYLOAD_SKIBOOT
```

## src/mainboard/dell/optiplex_7010/Kconfig
```kconfig
if BOARD_DELL_OPTIPLEX_7010

config BOARD_SPECIFIC_OPTIONS # dummy
	def_bool y
	select BOARD_ROMSIZE_KB_12288
	select HAVE_ACPI_RESUME
	select HAVE_ACPI_TABLES
	select INTEL_INT15
	select NORTHBRIDGE_INTEL_IVYBRIDGE
	select SANDYBRIDGE_IVYBRIDGE_LVDS
	select SERIRQ_CONTINUOUS_MODE
	select SOUTHBRIDGE_INTEL_C216
	select USE_NATIVE_RAMINIT
	select MAINBOARD_HAS_LPC_TPM
	select MAINBOARD_HAS_TPM1
	select MAINBOARD_USES_IFD_GBE_REGION
	select SUPERIO_SMSC_SCH5545

config HAVE_IFD_BIN
	bool
	default n

config HAVE_ME_BIN
	bool
	default n

config MAINBOARD_DIR
	string
	default dell/optiplex_7010

config MAINBOARD_PART_NUMBER
	string
	default "OptiPlex 7010"

config MAINBOARD_PCI_SUBSYSTEM_DEVICE_ID
	hex
	default 0x577

config MAINBOARD_PCI_SUBSYSTEM_VENDOR_ID
	hex
	default 0x1028

config DRAM_RESET_GATE_GPIO # FIXME: check this
	int
	default 60

config MAX_CPUS
	int
	default 8

config USBDEBUG_HCD_INDEX # FIXME: check this
	int
	default 2
endif
```

## src/mainboard/dell/optiplex_9010/Kconfig
```kconfig
if BOARD_DELL_OPTIPLEX_9010

config BOARD_SPECIFIC_OPTIONS
	def_bool y
	select BOARD_ROMSIZE_KB_12288
	select HAVE_ACPI_RESUME
	select HAVE_ACPI_TABLES
	select INTEL_INT15
	select NORTHBRIDGE_INTEL_IVYBRIDGE
	select SERIRQ_CONTINUOUS_MODE
	select SOUTHBRIDGE_INTEL_C216
	select USE_NATIVE_RAMINIT
	select MAINBOARD_HAS_LPC_TPM
	select MAINBOARD_HAS_TPM1
	select MAINBOARD_USES_IFD_GBE_REGION
	select SUPERIO_SMSC_SCH5545
	select MAINBOARD_HAS_LIBGFXINIT
	select INTEL_GMA_HAVE_VBT
	select HAVE_OPTION_TABLE
	select HAVE_CMOS_DEFAULT

config MAINBOARD_DIR
	string
	default dell/optiplex_9010

config MAINBOARD_PART_NUMBER
	string
	default "OptiPlex 9010"

config VGA_BIOS_FILE
	string
	default "pci8086,0162.rom"

config VGA_BIOS_ID
	string
	default "8086,0162"

config MAINBOARD_PCI_SUBSYSTEM_DEVICE_ID
	hex
	default 0x52c

config MAINBOARD_PCI_SUBSYSTEM_VENDOR_ID
	hex
	default 0x1028

config DRAM_RESET_GATE_GPIO # FIXME: check this
	int
	default 60

config MAX_CPUS
	int
	default 8

config USBDEBUG_HCD_INDEX # FIXME: check this
	int
	default 2

config CBFS_SIZE
	hex
	default 0x600000

endif
```

## src/soc/ibm/power9/Kconfig
```kconfig
config SOC_IBM_POWER9
	bool
	help
	  This SoC is the minimal template working on POWER9
	  Talos II platform.

if SOC_IBM_POWER9
	# nothing here yet
endif
```

## src/soc/raptor-cs/power9/Kconfig
```kconfig
config SOC_RAPTOR_POWER9
	bool
	select ARCH_BOOTBLOCK_POWER9
	select ARCH_VERSTAGE_POWER9
	select ARCH_ROMSTAGE_POWER9
	select ARCH_RAMSTAGE_POWER9
```
